## boards/training/Kconfig
```kconfig
# Copyright 2024-2025 NXP
# SPDX-License-Identifier: Apache-2.0

config BOARD_TRAINING
	select BOARD_EARLY_INIT_HOOK
```

## boards/training/Kconfig.training
```kconfig
# Copyright 2024 NXP
# SPDX-License-Identifier: Apache-2.0

config BOARD_TRAINING
	select SOC_MCXA156 if BOARD_TRAINING
	select SOC_PART_NUMBER_MCXA156VLL
```

## boards/training/board.yml
```yaml
board:
  name: training
  full_name: Packt Training Board
  vendor: nxp
  socs:
  - name: mcxa156
```

## west.yml
```yaml
manifest:
  version: 1.0

  projects:
    - name: zephyr
      url: https://github.com/zephyrproject-rtos/zephyr
      revision: v4.4.0
      import:
        name-allowlist:
          - cmsis_6
          - hal_nxp
          - mcuboot
          - mbedtls
          - tf-psa-crypto
          - zcbor
        path-prefix: deps
```
